## Kconfig
```kconfig
#
# Codezero L4 Microkernel Configuration
#

mainmenu "Codezero Microkernel Configurator"

config CODEZERO_VERSION
	string
	default "0.1"
	help
	  Version string for the Codezero microkernel.

source "arch/Kconfig"
source "platform/Kconfig"
source "kernel/Kconfig"
source "conts/Kconfig"

menu "Toolchain"

config TOOLCHAIN_USERSPACE
	string "Toolchain prefix for userspace"
	default "arm-none-eabi-"
	help
	  Toolchain used for compiling userspace libraries and containers.

	  Userspace is tested for an up-to-date CodeSourcery NONE-EABI-LINUX
	  toolchain.

	  To specify a custom toolchain, use:
	    path/to/toolchain/toolchain-prefix

config TOOLCHAIN_KERNEL
	string "Toolchain prefix for kernel"
	default "arm-none-eabi-"
	help
	  Toolchain used for compiling kernel and loader.

	  Kernel is tested for an up-to-date CodeSourcery EABI toolchain.

	  To specify a custom toolchain, use:
	    path/to/toolchain/toolchain-prefix

endmenu

config CAPABILITIES
	bool "Enable capability checking"
	default y
	help
	  Enable or disable capability checking by the kernel.

	  Capabilities provide fine-grained access control for kernel
	  resources including threads, address spaces, IPC endpoints,
	  and memory regions.
```

## arch/Kconfig
```kconfig
#
# Architecture Configuration
#

choice
	prompt "Main architecture"
	default ARCH_ARM
	help
	  Select the main processor architecture.

config ARCH_ARM
	bool "ARM"
	help
	  ARM architecture support.

	  Supports ARMv5, ARMv6 variants.

endchoice

if ARCH_ARM
source "arch/arm/Kconfig"
endif
```

## arch/arm/Kconfig
```kconfig
#
# ARM Architecture Configuration
#

menu "ARM Architecture Configuration"

choice
	prompt "ARM CPU type"
	default CPU_ARM926
	help
	  Select the type of ARM CPU/processor to be used.

config CPU_ARM926
	bool "ARM926EJ-S"
	depends on PLATFORM_PB926
	help
	  ARMv5/ARM9 series based uniprocessor CPU.

config CPU_ARM1136
	bool "ARM1136 (Experimental)"
	depends on PLATFORM_EB
	help
	  ARMv6/ARM11 series based uniprocessor CPU.

config CPU_ARM11MPCORE
	bool "ARM11 MPCore (Experimental)"
	depends on PLATFORM_EB
	help
	  ARMv6/ARM11 series based multiprocessor CPU.

endchoice

# Derived sub-architecture symbols (computed, not user-selectable)
config SUBARCH_V5
	bool
	default y if CPU_ARM926
	help
	  ARMv5 sub-architecture. Automatically selected based on CPU type.

config SUBARCH_V6
	bool
	default y if CPU_ARM1136 || CPU_ARM11MPCORE
	help
	  ARMv6 sub-architecture. Automatically selected based on CPU type.

endmenu
```

## configs/eb_defconfig
```kconfig
#
# Codezero Realview EB Default Configuration
#

# Architecture
CONFIG_ARCH_ARM=y

# CPU (ARM11 MPCore for SMP testing)
CONFIG_CPU_ARM11MPCORE=y

# Platform
CONFIG_PLATFORM_EB=y

# Toolchain
CONFIG_TOOLCHAIN_USERSPACE="arm-none-eabi-"
CONFIG_TOOLCHAIN_KERNEL="arm-none-eabi-"

# Capabilities
CONFIG_CAPABILITIES=y

# Processor properties (SMP enabled for MPCore)
CONFIG_SMP=y
CONFIG_NCPU=4
# CONFIG_ICACHE_DISABLE is not set
# CONFIG_DCACHE_DISABLE is not set

# Kernel properties
# CONFIG_PREEMPT_DISABLE is not set
CONFIG_SCHED_TICKS=1000

# Debug options
# CONFIG_DEBUG_ACCOUNTING is not set
# CONFIG_DEBUG_PERFMON is not set
# CONFIG_DEBUG_PERFMON_USER is not set
# CONFIG_DEBUG_SPINLOCKS is not set
```

## configs/kmi_service_defconfig
```kconfig
#
# Codezero PB926 KMI Service Configuration
#

# Architecture
CONFIG_ARCH_ARM=y

# CPU
CONFIG_CPU_ARM926=y

# Platform
CONFIG_PLATFORM_PB926=y

# Toolchain
CONFIG_TOOLCHAIN_USERSPACE="arm-none-eabi-"
CONFIG_TOOLCHAIN_KERNEL="arm-none-eabi-"

# Capabilities
CONFIG_CAPABILITIES=y

# Kernel properties
CONFIG_SCHED_TICKS=1000

# Containers
CONFIG_CONT_BAREMETAL_KMI_SERVICE=y
```

## configs/pb926_defconfig
```kconfig
#
# Codezero PB926 Default Configuration
#

# Architecture
CONFIG_ARCH_ARM=y

# CPU
CONFIG_CPU_ARM926=y

# Platform
CONFIG_PLATFORM_PB926=y

# Toolchain
CONFIG_TOOLCHAIN_USERSPACE="arm-none-eabi-"
CONFIG_TOOLCHAIN_KERNEL="arm-none-eabi-"

# Capabilities
CONFIG_CAPABILITIES=y

# Processor properties
# CONFIG_SMP is not set
# CONFIG_ICACHE_DISABLE is not set
# CONFIG_DCACHE_DISABLE is not set

# Kernel properties
# CONFIG_PREEMPT_DISABLE is not set
CONFIG_SCHED_TICKS=1000

# Debug options
# CONFIG_DEBUG_ACCOUNTING is not set
# CONFIG_DEBUG_PERFMON is not set
# CONFIG_DEBUG_PERFMON_USER is not set
# CONFIG_DEBUG_SPINLOCKS is not set

# Containers
CONFIG_CONT_BAREMETAL_HELLO_WORLD=y
# CONFIG_CONT_BAREMETAL_EMPTY is not set
# CONFIG_CONT_BAREMETAL_IPC_DEMO is not set
# CONFIG_CONT_BAREMETAL_KMI_SERVICE is not set
# CONFIG_CONT_BAREMETAL_MUTEX_DEMO is not set
# CONFIG_CONT_BAREMETAL_TEST_SUITE is not set
# CONFIG_CONT_BAREMETAL_THREADS_DEMO is not set
# CONFIG_CONT_BAREMETAL_TIMER_SERVICE is not set
# CONFIG_CONT_BAREMETAL_UART_SERVICE is not set
# CONFIG_CONT_POSIX_MM0 is not set
# CONFIG_CONT_POSIX_TEST0 is not set
```

## configs/posix_test0_defconfig
```kconfig
CONFIG_ARCH_ARM=y
CONFIG_CPU_ARM926=y
CONFIG_PLATFORM_PB926=y
CONFIG_TOOLCHAIN_USERSPACE="arm-none-eabi-"
CONFIG_TOOLCHAIN_KERNEL="arm-none-eabi-"
CONFIG_CAPABILITIES=y
CONFIG_SCHED_TICKS=1000
CONFIG_CONT_POSIX_TEST0=y
```

## conts/Kconfig
```kconfig
#
# Container Selection
#
# Select which container to build and include in the final image.
#

menu "Containers"

choice
	prompt "Container to build"
	default CONT_BAREMETAL_HELLO_WORLD
	help
	  Select which container to build and run.
	  Only one container can be selected at a time.

comment "Baremetal Containers"

config CONT_BAREMETAL_EMPTY
	bool "empty - Minimal container template"
	help
	  A minimal baremetal container that does nothing.
	  Useful as a template for new container development.

config CONT_BAREMETAL_HELLO_WORLD
	bool "hello_world - Hello World demo"
	help
	  Simple hello world container demonstrating basic L4 functionality.
	  Prints a message via UART and exercises basic syscalls.

config CONT_BAREMETAL_IPC_DEMO
	bool "ipc_demo - IPC demonstration"
	help
	  Demonstrates inter-process communication between threads
	  using L4 IPC primitives (send, receive, call).

config CONT_BAREMETAL_KMI_SERVICE
	bool "kmi_service - Keyboard/Mouse interface service"
	help
	  PS/2 keyboard and mouse interface service container.
	  Handles KMI hardware and provides input events.

config CONT_BAREMETAL_MUTEX_DEMO
	bool "mutex_demo - Mutex demonstration"
	help
	  Demonstrates mutex synchronization primitives.
	  Shows proper locking between concurrent threads.

config CONT_BAREMETAL_TEST_SUITE
	bool "test_suite - Kernel test suite"
	help
	  Comprehensive test suite for kernel functionality.
	  Tests IPC, memory management, scheduling, and capabilities.

config CONT_BAREMETAL_THREADS_DEMO
	bool "threads_demo - Threading demonstration"
	help
	  Demonstrates thread creation and management.
	  Shows thread lifecycle, priorities, and scheduling.

config CONT_BAREMETAL_TIMER_SERVICE
	bool "timer_service - Timer service"
	help
	  System timer service container.
	  Provides timing services to other containers.

config CONT_BAREMETAL_UART_SERVICE
	bool "uart_service - UART service"
	help
	  UART driver service container.
	  Provides serial I/O services to other containers.

comment "POSIX Containers"

config CONT_POSIX_MM0
	bool "mm0 - POSIX memory manager"
	help
	  POSIX-compatible memory manager (pager).
	  Provides virtual memory services for POSIX containers.

config CONT_POSIX_TEST0
	bool "test0 - POSIX test container"
	help
	  Test container for POSIX compatibility layer.
	  Note: Also requires mm0 for full POSIX support.

endchoice

config NCONTAINERS
	int
	default 1
	help
	  Number of containers in the final image.

endmenu
```

## kernel/Kconfig
```kconfig
#
# Generic Kernel Properties
#

menu "Generic Processor Properties"

config SMP
	bool "Enable SMP Support"
	default y
	depends on CPU_ARM11MPCORE
	help
	  Enable or disable SMP (Symmetric Multi-Processing) support.

	  Only available for multiprocessor cores like ARM11 MPCore.

config NCPU
	int "Number of SMP CPUs"
	default 4
	range 1 4
	depends on SMP
	help
	  Configure the number of CPUs in case of multiprocessor cores.

	  Maximum supported is 4 CPUs.

config ICACHE_DISABLE
	bool "Disable the L1 instruction cache"
	default n
	help
	  Disable usage of L1 instruction cache by the processor.

	  This is primarily useful for debugging cache-related issues.

config DCACHE_DISABLE
	bool "Disable the L1 data cache"
	default n
	help
	  Disable usage of L1 data cache by the processor.

	  This is primarily useful for debugging cache-related issues.

endmenu

menu "Generic Kernel Properties"

config PREEMPT_DISABLE
	bool "Disable Kernel Preemption"
	default n
	help
	  Disable preemption of the kernel.

	  When enabled, the kernel will not be preempted by higher priority
	  tasks while executing kernel code.

config SCHED_TICKS
	int "Scheduler ticks per second"
	default 1000
	range 100 10000
	help
	  Configure the number of ticks generated per second by the timer
	  source of the scheduler.

	  Higher values provide finer-grained scheduling but increase
	  timer interrupt overhead.

endmenu

menu "Debug Options"

config DEBUG_ACCOUNTING
	bool "Enable system operations accounting"
	default n
	help
	  Enable or disable system operations accounting.

	  By default, operation accounting in kernel is enabled.
	  To enable operation accounting in userspace, enable
	  DEBUG_PERFMON_USER.

config DEBUG_PERFMON
	bool "Enable performance monitoring"
	default n
	depends on DEBUG_ACCOUNTING
	help
	  Enable or disable system performance monitoring.

	  Requires DEBUG_ACCOUNTING to be enabled.

config DEBUG_PERFMON_USER
	bool "Userspace access to perfmon registers"
	default n
	depends on DEBUG_PERFMON
	help
	  Enable or disable userspace access to processor's performance
	  registers.

	  Enabling this option will automatically disable in-kernel
	  measurements.

# Derived symbol: kernel perfmon active when accounting enabled but not user
config DEBUG_PERFMON_KERNEL
	bool
	default y if DEBUG_PERFMON && !DEBUG_PERFMON_USER
	help
	  Internal symbol: kernel performance monitoring is active.

config DEBUG_SPINLOCKS
	bool "Debug spinlocks"
	default n
	help
	  Enable or disable spinlock debugging by the kernel.

	  Detects recursive locks, double unlocks, and other
	  spinlock-related bugs.

endmenu
```

## platform/Kconfig
```kconfig
#
# Platform Configuration
#

menu "Platform Selection"

choice
	prompt "ARM Platform Type"
	default PLATFORM_PB926
	depends on ARCH_ARM
	help
	  Select the type of ARM platform to be used.

config PLATFORM_PB926
	bool "PB926 Versatile Platform"
	help
	  ARMv5 based Versatile PB platform.

	  This platform uses the ARM926EJ-S processor.

config PLATFORM_EB
	bool "Realview EB Platform"
	help
	  ARMv6 based Realview EB platform.

	  Supported CPUs:
	    - ARM1136
	    - ARM11 MPCore

endchoice

# Driver auto-selection based on platform
config DRIVER_UART_PL011
	bool
	default y if PLATFORM_PB926 || PLATFORM_EB
	help
	  PL011 UART driver. Automatically selected for supported platforms.

config DRIVER_TIMER_SP804
	bool
	default y if PLATFORM_PB926 || PLATFORM_EB
	help
	  SP804 timer driver. Automatically selected for supported platforms.

config DRIVER_IRQ_PL190
	bool
	default y if PLATFORM_PB926
	help
	  PL190 VIC (Vectored Interrupt Controller) driver.
	  Automatically selected for PB926 platform.

config DRIVER_IRQ_GIC
	bool
	default y if PLATFORM_EB
	help
	  GIC (Generic Interrupt Controller) driver.
	  Automatically selected for EB platform.

endmenu
```
