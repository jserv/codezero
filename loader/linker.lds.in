/****
 ****  Template for generating a linker.lds.  Edit markers have replaced some items in the original file
 ****
 ****  Copyright © 2009  B Labs Ltd
 ****
 ****  Author: Russel Winder.
 ****/

/*
 * Simple linker script for userspace or svc tasks.
 *
 * Copyright (C) 2007 Bahadir Balban
 */
ENTRY(_start)

SECTIONS
{
	. = 0x2000000;
	.text : { *(.text) }
	.rodata : { *(.rodata) }
	.rodata1 : { *(.rodata1) }
	.data :
	{
__LINKER_ITEMS_EDIT_MARKER__
		*(.data)
	}
	.got : { *(.got) *(.got.plt) }
	.bss : { *(.bss) }
}
